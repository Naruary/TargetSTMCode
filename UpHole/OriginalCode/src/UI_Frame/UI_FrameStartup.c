/*******************************************************************************
*       @brief      Implementation file for the startup screen.
*       @file       Uphole/src/UI_Frame/UI_FrameStartup.c
*       @date       December 2014
*       @copyright  COPYRIGHT (c) 2014 Target Drilling Inc. All rights are
*                   reserved.  Reproduction in whole or in part is prohibited
*                   without the prior written consent of the copyright holder.
*******************************************************************************/

//============================================================================//
//      INCLUDES                                                              //
//============================================================================//

#include <stdbool.h>
#include <stdio.h>
#include <stdlib.h>
#include <string.h>
#include "portable.h"
#include "PeriodicEvents.h"
#include "FlashMemory.h"
#include "SysTick.h"
#include "UI_api.h"
#include "UI_Defs.h"
#include "UI_Alphabet.h"
#include "UI_Frame.h"
#include "UI_LCDScreenInversion.h"
#include "UI_ScreenUtilities.h"
#include "version.h"

//============================================================================//
//      FUNCTION PROTOTYPES                                                   //
//============================================================================//

//   Contains the individual animation steps
static void showStartupScreen(void);
static void UI_DrawLogo(void);

//============================================================================//
//      DATA DEFINITIONS                                                      //
//============================================================================//

static const U_BYTE nMwdLogo[] ={
0x00,0x00,0x00,0x00,0x00,0x00,0x00,0x00,0x00,0x00,0x00,0x00,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0x00,
0x00,0x00,0x00,0x00,0x00,0x00,0x00,0x00,0x00,0x00,0x00,0x00,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0x00,
0x00,0x00,0x00,0x00,0x00,0x00,0x00,0x00,0x00,0x00,0x00,0x00,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0x00,
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0x00,0x00,0x00,0x00,0x00,0x00,0x00,0x00,0x00,0x00,0x00,0x00,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0x00,
// 0x00,0x00,0x00,0x00,0x00,0x00,0x00,0x00,0x00,0x00,0x00,0xFE,0x0F,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0x00,
// 0x00,0x00,0x00,0x00,0x00,0x00,0x00,0x00,0x00,0x00,0x00,0x10,0x08,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0x00,
// 0x00,0x00,0x00,0x00,0x00,0x00,0x00,0x00,0x00,0x00,0x00,0x10,0x0F,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0x00,
// 0x00,0x00,0x00,0x00,0x00,0x00,0x00,0x00,0x00,0x00,0x00,0x10,0x08,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0x00,
// 0x00,0x00,0x00,0x00,0x00,0x00,0x00,0x00,0x00,0x00,0x00,0x10,0x0F,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0x00,
// 15Oct2019 whs commented out the above 5 lines to remove Technologies from the logo
0x00,0x00,0x00,0x00,0x00,0x00,0x00,0x00,0x00,0x00,0x00,0x00,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0x00,
0x00,0x00,0x00,0x00,0x00,0x00,0x00,0x00,0x00,0x00,0x00,0x00,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0x00,
0x00,0x00,0x00,0x00,0x00,0x00,0x00,0x00,0x00,0x00,0x00,0x00,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0x00,
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0x00,0x00,0x00,0x00,0x00,0x00,0x00,0x00,0x00,0x00,0x00,0x00,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0x00,
};


//============================================================================//
//      FUNCTION IMPLEMENTATIONS                                              //
//============================================================================//

/*!
 ********************************************************************************
 *       @details
 *******************************************************************************/

void StartupFrameHandler(PERIODIC_EVENT * pEvent)
{
	if (pEvent == NULL)
	{
		return;
	}

	switch (pEvent->Action.eActionType)
	{
		case SCREEN:
			switch (pEvent->Action.ScreenTask)
			{
				case ANIMATION:
					M_Turn_LCD_On_And_Reset_Timer();
					showStartupScreen();
					break;
				default:
					break;
			}
			break;

		case PUSH:
		case NO_ACTION:
		default:
			break;
	}
}

/*!
 ********************************************************************************
 *       @details
 *******************************************************************************/
/*
 ;~~~~~~~~~~~~~~~~~~~~~~~~~~~~~~~~~~~~~~~~~~~~~~~~~~~~~~~~~~~~~~~~~~~~~~~~~~~~
 ; Function:
 ;   showStartupScreen()
 ;
 ; Description:
 ;   Handles the startup animation sequence.
 ;
 ; Reentrancy:
 ;   No.
 ;
 ;~~~~~~~~~~~~~~~~~~~~~~~~~~~~~~~~~~~~~~~~~~~~~~~~~~~~~~~~~~~~~~~~~~~~~~~~~~~~
 */
static void showStartupScreen(void)
{
	char sTxtString[50];
	static enum ANIMATION_STEPS eStartupAnimationStep = ANIMATION1;
	static TIME_LR tStartupTimer = (TIME_LR) 0;

	UI_FlushBothEventQueues();

	switch (eStartupAnimationStep)
	{
		// This is the init and display of the Logo
		case ANIMATION1:

			UI_DrawLogo();
			eStartupAnimationStep = ANIMATION2;
			tStartupTimer = ElapsedTimeLowRes((TIME_LR) 0);
			SetLoggingState(NOT_LOGGING);
			break;

			// After 2 seconds of displaying the logo.  Clear the screen and
			// show that.
		case ANIMATION2:
			if (ElapsedTimeLowRes(tStartupTimer) >= (TWO_SECOND))
			{
				clearLCD();
				eStartupAnimationStep = ANIMATION3;
				tStartupTimer = ElapsedTimeLowRes((TIME_LR) 0);
			}
			break;
			// A very short 200mS later put up the version # screen.
		case ANIMATION3:
			snprintf(sTxtString, 50, "   TARGET DRILLING, INC.");
			//     15Oct2019 whs above line modified from Target Technologies LLC...and added a few spaces to center the text
			UI_DisplayString(sTxtString, (RECT*) &StartupFrame.area, 70, 72);
			snprintf(sTxtString, 50, "MAGNESTAR MWD 100");
			UI_DisplayString(sTxtString, (RECT*) &StartupFrame.area, 95, 96);
			snprintf(sTxtString, 50, (CHAR*) GetTxtString(TXT_VERSION), (CHAR*) (GetSWVersion()));
			UI_DisplayString(sTxtString, (RECT*) &StartupFrame.area, 120, 87);
			snprintf(sTxtString, 50, (CHAR*) "Build date %s", __DATE__);
			UI_DisplayString(sTxtString, (RECT*) &StartupFrame.area, 145, 81);
			snprintf(sTxtString, 50, "COPYRIGHT (c) 2022");
			UI_DisplayString(sTxtString, (RECT*) &StartupFrame.area, 170, 96);
			eStartupAnimationStep = ANIMATION4;
			tStartupTimer = ElapsedTimeLowRes((TIME_LR) 0);
			break;
			// Finally 2 seconds after that clear the screen and immediately
			// show the home screen.
		case ANIMATION4:
			if (ElapsedTimeLowRes(tStartupTimer) >= (FOUR_SECOND))
			{
				TAB_ENTRY *tab = GetActiveTab();
				UI_ClearLCDArea(&StartupFrame.area, LCD_FOREGROUND_PAGE);
				UI_SetActiveFrame(&HomeFrame);
				tab->Show(tab);
				RepaintNow(&HomeFrame);
				UI_SetStartupComplete(true);
				return;
			}
			break;
		default:
			break;
	}
	LCD_Refresh(LCD_BACKGROUND_PAGE);
	LCD_Refresh(LCD_FOREGROUND_PAGE);
	AddScreenEvent(ANIMATION, STARTUP, TRIGGER_TIME_NOW);
}

/*!
 ********************************************************************************
 *       @details
 *******************************************************************************/

static void UI_DrawLogo(void)
{
	U_BYTE *pData = GetLcdForegroundPage();
	pData += 2400;
	memcpy(pData, nMwdLogo, 4760);
}
